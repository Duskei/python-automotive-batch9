AUTOSAR XML (schema 4-2-2)
package /ECU_Config
  constant specification CAN_BAUDRATE: value-spec=CAN_BAUDRATE:500000
  constant specification ECU_ID: value-spec=ECU_ID:300
